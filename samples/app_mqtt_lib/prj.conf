## CMakeLists.txt
```
cmake_minimum_required(VERSION 3.20.0)
find_package(Zephyr REQUIRED HINTS $ENV{ZEPHYR_BASE})
project(app_mqtt_lib_basic)

target_sources(app PRIVATE src/main.c)
```

## prj.conf
```kconfig
CONFIG_APP_MQTT_LIB=y
CONFIG_LOG=y
CONFIG_LOG_DEFAULT_LEVEL=3

CONFIG_NETWORKING=y
CONFIG_MQTT_LIB=y
```

## src/main.c
```c
#include <app_mqtt_lib/app_mqtt_lib.h>
#include <zephyr/kernel.h>

int main(void) {
  app_mqtt_lib_init(NULL, NULL);

  int result = app_mqtt_lib_do_something(21);
  printk("Result = %d\n", result);

  while (1) {
    k_sleep(K_SECONDS(1));
  }
}
```
